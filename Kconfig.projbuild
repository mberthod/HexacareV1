## Kconfig.projbuild
```kconfig
menu "LexaCare AI Engine"

    config AI_USE_ESPDL_MODEL
        bool "Utiliser le modèle ESP-DL pour la détection de chute"
        default n
        help
            Activé  : charge le fichier /littlefs/fall_model.espdl
                      via l'API ESP-DL et exécute l'inférence CNN.
            Désactivé : utilise l'algorithme géométrique à seuil
                        (CONFIG_AI_FALL_THRESHOLD_PERCENT).
            Le basculement ne nécessite qu'un 'idf.py menuconfig'
            suivi d'une recompilation — aucun changement de code.

    config AI_FALL_THRESHOLD_PERCENT
        int "Seuil de chute — variation de distance minimale (%)"
        depends on !AI_USE_ESPDL_MODEL
        default 80
        range 1 100
        help
            Mode seuil uniquement.
            Pourcentage de variation relative des distances LIDAR
            dans la zone inférieure de la matrice 8x32,
            au-delà duquel AI_CHUTE_DETECTEE est généré.

    config AI_FALL_CONFIDENCE_THRESHOLD
        int "Seuil de confiance du modèle ESP-DL (%)"
        depends on AI_USE_ESPDL_MODEL
        default 85
        range 50 100
        help
            Mode modèle uniquement.
            Probabilité minimale (0–100 %) retournée par la
            sortie softmax du modèle pour confirmer une chute.

    config AI_HISTORY_LEN
        int "Longueur de l'historique pour le filtrage temporel"
        default 8
        range 2 32
        help
            Nombre de trames LIDAR conservées pour le calcul
            de la variation de distance (mode seuil) ou pour
            le lissage de la confiance (mode modèle).

endmenu
```

## components/mesh_manager/Kconfig
```kconfig
menu "Mesh Manager"

    config MESH_PRIMARY_LOSS_THRESHOLD_PCT
        int "Loss threshold to trigger fallback (%)"
        default 20
        range 5 90
        help
            Si la fraction de paquets ESP-NOW non-ACK dépasse ce seuil sur
            la fenêtre glissante, bascule en WIFI-MESH.

    config MESH_LOSS_WINDOW_MS
        int "Loss measurement window (ms)"
        default 10000
        range 1000 60000

    config MESH_LOSS_MIN_SAMPLES
        int "Min packets in window before evaluating loss"
        default 20
        range 5 1000
        help
            Empêche une bascule déclenchée par 1 échec sur 2 paquets.

    config MESH_PROBE_INTERVAL_MS
        int "Probe interval when in fallback (ms)"
        default 60000
        range 10000 600000

    config MESH_PROBE_CONSECUTIVE_OK
        int "Consecutive successful probes to restore Primary"
        default 3
        range 1 10

    config MESH_PROBE_RSSI_MIN_DBM
        int "Min RSSI (dBm) to accept return to Primary"
        default -80
        range -100 -40

    config MESH_TX_QUEUE_DEPTH
        int "TX queue depth per priority"
        default 16
        range 4 64

endmenu
```

## sdkconfig.defaults
```kconfig
# sdkconfig.defaults — mbh-firmware unified
#
# PSRAM octal (requis pour ring buffers audio + arenas TFLM + buffers mesh)
CONFIG_ESP32S3_SPIRAM_SUPPORT=y
CONFIG_SPIRAM_MODE_OCT=y
CONFIG_SPIRAM_SPEED_80M=y
CONFIG_SPIRAM_BOOT_INIT=y
CONFIG_SPIRAM_USE_MALLOC=y
CONFIG_SPIRAM_USE_CAPS_ALLOC=y

# WiFi — APSTA requis pour ESP-WIFI-MESH, power save OFF pour ESP-NOW
CONFIG_ESP32_WIFI_ENABLED=y
CONFIG_ESP32_WIFI_STATIC_RX_BUFFER_NUM=10
CONFIG_ESP32_WIFI_DYNAMIC_RX_BUFFER_NUM=32
CONFIG_ESP32_WIFI_DYNAMIC_TX_BUFFER_NUM=32
CONFIG_PM_ENABLE=n

# ESP-WIFI-MESH
CONFIG_MESH_ENABLE=y
CONFIG_MESH_MAX_LAYER=6
CONFIG_MESH_ROUTE_TABLE_SIZE=50
CONFIG_MESH_WAIVE_ROOT=y

# FreeRTOS
CONFIG_FREERTOS_HZ=1000
CONFIG_FREERTOS_CHECK_STACKOVERFLOW_CANARY=y
CONFIG_FREERTOS_USE_TRACE_FACILITY=y

# Log
CONFIG_LOG_DEFAULT_LEVEL_INFO=y
CONFIG_LOG_COLORS=y

# Console sur USB Serial/JTAG (ESP32-S3) — UART0 libre pour le radar (pas de conflit avec ESP_LOG / stdout)
# Débit moniteur / outil série (aligné platformio.ini). USB-JTAG : débit effectif surtout USB ; valeur utile pour adaptateurs UART.
CONFIG_ESPTOOLPY_MONITOR_BAUD=921600
# CONFIG_ESP_CONSOLE_UART_DEFAULT is not set
CONFIG_ESP_CONSOLE_USB_SERIAL_JTAG=y
# CONFIG_ESP_CONSOLE_USB_CDC is not set
# CONFIG_ESP_CONSOLE_UART_CUSTOM is not set
# CONFIG_ESP_CONSOLE_NONE is not set
CONFIG_ESP_CONSOLE_SECONDARY_NONE=y
# CONFIG_ESP_CONSOLE_SECONDARY_USB_SERIAL_JTAG is not set

# OTA (secure boot à activer quand on passera en prod)
CONFIG_BOOTLOADER_ROLLBACK_ENABLE=y
CONFIG_APP_ROLLBACK_ENABLE=y

# Compilation
CONFIG_COMPILER_OPTIMIZATION_PERF=y

# Fix PlatformIO mbedTLS bug (Disable certificate bundle)
CONFIG_MBEDTLS_CERTIFICATE_BUNDLE=n
```
